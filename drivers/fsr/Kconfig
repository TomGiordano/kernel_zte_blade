## drivers/fsr/Kconfig
```kconfig
#
# Unified Flash Device configuration
#

menu "LinuStoreIII Flash Devices (FSR)"

config RFS_FSR
	tristate "BML block device support"
	default m
	help
		eXtended Sector Remapper device

config RFS_FSR_STL
	tristate "STL block device support"
	depends on RFS_FSR
	select RFS_MAPDESTROY
	default m
	help
		STL block device support

config RFS_STL_DELETE
	bool "STL delete support"
	depends on RFS_FSR_STL
	default y
	help
		STL delete support

config RFS_FSR_STL_BENCHMARK
	tristate "FSR benchmark tool support"
	depends on RFS_FSR
	help
		FSR benchmark tool.

config FSR_DUAL_VOLUME
	bool "Multi Volume Flex-OneNAND support (Experimental)"
	depends on RFS_FSR
	default n
	help
		Support dual Flex-OneNAND flash memory.

config FSR_FLASH_PHYS_ADDR
	hex "1st Volume Flex-OneNAND flash Physical Location"
	depends on RFS_FSR
	default "0x00100000"
	help
		This is the physical address in your flash memory the fsr will
		be linked for and stored to.  This address is dependent on your
		own flash usage.

config FSR_FLASH_PHYS_ADDR2
	hex "2nd Volume Flex-OneNAND flash Physical Location"
	depends on FSR_DUAL_VOLUME
	default "0x0A000000"
	help
		This is the physical address in your second flash memory to support
		dual-chips. The fsr will be linked for and stored to. This address
		is dependent on your own flash usage.

config LINUSTOREIII_DEBUG_VERBOSE
	int "LinuStoreIII Debugging verbosity (0 = quiet, 3 = noisy)"
	depends on RFS_FSR
	default 0

config LINUSTOREIII_DEBUG
	bool
	depends on RFS_FSR
	default y

endmenu
```

## drivers/i2c/chips/Kconfig
```kconfig
#
# Miscellaneous I2C chip drivers configuration
#
# *** DEPRECATED! Do not add new entries! See Makefile ***
#

menu "Miscellaneous I2C Chip support"

config DS1682
	tristate "Dallas DS1682 Total Elapsed Time Recorder with Alarm"
	depends on EXPERIMENTAL
	help
	  If you say yes here you get support for Dallas Semiconductor
	  DS1682 Total Elapsed Time Recorder.

	  This driver can also be built as a module.  If so, the module
	  will be called ds1682.

config MSENSORS_FROM_AUXI2C_TO_I2C
	tristate "Add this feature to change msensors from aux-i2c to i2c"
	depends on I2C
	default n
	help
	  Here is one feature to match hardware ,used by fya.

config GSENSORS_FROM_AUXI2C_TO_I2C
	tristate "Add this feature to to change gsensors from aux-i2c to i2c"
	depends on I2C
	default n
	help
	  Here is one feature to match hardware ,used by fya.

config SENSORS_TSL2550
	tristate "Taos TSL2550 ambient light sensor"
	depends on EXPERIMENTAL
	help
	  If you say yes here you get support for the Taos TSL2550
	  ambient light sensor.

	  This driver can also be built as a module.  If so, the module
	  will be called tsl2550.

config SENSORS_TSL2771
	tristate "Taos TSL2771 ambient light and prox sensor"
	depends on I2C
	default n
	help
	  If you say yes here you get support for the Taos TSL2771
	  ambient light and prox sensor.
	  
config SENSORS_BH1721
	tristate "BH1721 ambient light sensor"
	depends on I2C
	default n
	help
	  If you say yes here you get support for the BH1721
	  ambient light sensor.	   

config SENSORS_AKM8962
	tristate "AK8962 Compass Driver"
	depends on I2C
	default n
	help
	  If you say yes here you get support for Asahi Kasei's 
	  orientation sensor AK8962.	
	  
config SENSORS_AK8973
	tristate "AKM8973 Compass Driver"
	depends on I2C
	default n
	help
	  If you say yes here you get support for Asahi Kasei's 
	  orientation sensor AK8973.
	  
config SENSORS_AKM8976
	tristate "AKM8976 Compass Driver"
	depends on I2C
	help
	 AKM8976 Compass Driver implemented by HTC.

config SENSOR_LIS302DL
        tristate "ST LIS302DL acceleration sensor support"
	depends on I2C
	default n
	help 
	  if your say yes here your get support for LIS302
	  acceleration sensor support 
	  
config SENSOR_ADXL34X
  tristate "ADI ADXL34X acceleration sensor support"
	depends on I2C
	default n
	help 
	  if your say yes here your get support for ADXL34X
	  acceleration sensor support 
	  
config SENSOR_ACCELERATOR
  tristate "To support ST&ADI acceleration sensor support"
	depends on I2C
	default n
	help 
	  if your say yes here your get support for both ST and ADI 
	  acceleration sensor support 

config SENSORS_PCA963X
	tristate "Philips PCA963X 4-bit I2C-bus LED"
	depends on I2C && EXPERIMENTAL
	help
	 If you say yes here you get support for the Philips PCA963X
	 4-bit I2C-bus LED.

	 This driver can also be built as a module.  If so, the module
	 will be called pca963X.

config SENSORS_MT9T013
	tristate "MT9T013 Camera Driver"
	depends on I2C
	default y
	help
	 MT9T013 Camera Driver implemented by HTC.
config NFC_PN544
	tristate "NXP PN544 Driver"
	depends on I2C
	default n
	help
	 ZTE NFC driver.

config VP_A1026
	tristate "A1026 Voice Processor Driver"
	depends on I2C
	help
	  A1026 Voice Processor Driver implemented by HTC.

endmenu
```

## drivers/media/video/msm/Kconfig
```kconfig
comment "Camera Sensor Selection"
config MT9T013
	bool "Sensor mt9t013 (BAYER 3M)"
	depends on MSM_CAMERA && !ARCH_MSM8X60
	default n
	---help---
	  MICRON 3M Bayer Sensor with AutoFocus

config MT9D112
	bool "Sensor mt9d112 (YUV 2M)"
	depends on MSM_CAMERA && !ARCH_MSM8X60
	default n
	---help---
	  MICRON 2M YUV Sensor
config IMX074
	bool "Sensor IMX074 (BAYER 13.5M)"
	depends on MSM_CAMERA && ARCH_MSM8X60
	default y
	---help---
	SONY 13.5 MP Bayer Sensor
config WEBCAM_OV7692
	bool "Sensor OV7692 (VGA YUV)"
	depends on MSM_CAMERA && ARCH_MSM8X60
	default y
	---help---
	  Omni Vision VGA YUV Sensor.
#	This Senosr is used as a webcam.
#	This uses the CSI interface.
#	Need to enable CSI1 clks for this sensor.
config VX6953
	bool "Sensor VX6953 (BAYER 5M)"
	depends on MSM_CAMERA && ARCH_MSM7X30
	default y
	---help---
	STM 5M Bayer Sensor with EDOF
config SN12M0PZ
	bool "Sensor sn12m0pz (Bayer 12 MP)"
	depends on MSM_CAMERA && ARCH_MSM7X30
	default y
	---help---
	  Sony 12 MP Bayer Sensor
config MT9P012
	bool "Sensor mt9p012 (BAYER 5M)"
	depends on MSM_CAMERA && !ARCH_MSM8X60
	default n
	---help---
	  MICRON 5M Bayer Sensor with Autofocus

config MT9V113
	bool "Sensor mt9v113 (YUV 0.3M)"
	depends on MSM_CAMERA && !ARCH_MSM8X60
	default n
	---help---
	  APTINA 0.3M YUV Sensor

config MT9P111
	bool "Sensor mt9p111 (YUV 5.0M)"
	depends on MSM_CAMERA && !ARCH_MSM8X60
	default n
	---help---
	  APTINA 5.0M YUV Sensor

if MT9P111
config MT9P111_MCNEX
	bool "Sensor mt9p111 (YUV 5.0M), Module MCNEX"
	depends on MSM_CAMERA && MT9P111
	default n
	---help---
	  APTINA 5.0M YUV Sensor, Module MCNEX

config MT9P111_SAMSUNG_FPC
	bool "Sensor mt9p111 (YUV 5.0M) of FPC, Module SAMSUNG"
	depends on MSM_CAMERA && MT9P111
	default n
	---help---
	  APTINA 5.0M YUV Sensor, Module SAMSUNG

config MT9P111_SAMSUNG_SOCKET
	bool "Sensor mt9p111 (YUV 5.0M) of socket, Module SAMSUNG"
	depends on MSM_CAMERA && MT9P111
	default y
	---help---
	  APTINA 5.0M YUV Sensor, Module SAMSUNG
endif # MT9P111
	  
config MT9T11X
	bool "Sensor mt9t111 or mt9t112 (YUV 3.1M)"
	depends on MSM_CAMERA && !ARCH_MSM8X60
	default y
	---help---
	  APTINA 3.1M YUV Sensor

if MT9T11X
config MT9T11X_QTECH_MCNEX_FPC
	bool "Sensor mt9t111 or mt9t112 (YUV 3.1M) of FPC, Module QTECHGLOBAL or MCNEX"
	depends on MSM_CAMERA
	depends on MACH_BLADE || MACH_SMOOTH || MACH_RAISE || MACH_V9 || MACH_ROAMER || MACH_NOVA || MACH_SAILBOAT
	default y
	---help---
	  APTINA 3.1M YUV Sensor

config MT9T11X_QTECH_MCNEX_SOCKET
	bool "Sensor mt9t111 or mt9t112 (YUV 3.1M) of socket, Module QTECHGLOBAL or MCNEX"
	depends on MSM_CAMERA
	depends on MACH_MOONCAKE || MACH_JOE || MACH_R750 || MACH_AMIGO
	default y
	---help---
	  APTINA 3.1M YUV Sensor
endif # MT9T11X

config OV5642
	bool "Sensor ov5642 (YUV 5.0M)"
	depends on MSM_CAMERA && !ARCH_MSM8X60
	default n
	---help---
	  OmniVision 5.0M YUV Sensor

if OV5642
config OV5642_GLOBALOPTICS
	bool "Sensor ov5642 (YUV 5.0M), Module GLOBALOPTICS"
	depends on MSM_CAMERA
	default y
	---help---
	  OmniVision 5.0M YUV Sensor, Module GLOBALOPTICS
endif # OV5642

config OV5640
	bool "Sensor ov5640 (YUV 5.0M)"
	depends on MSM_CAMERA && !ARCH_MSM8X60
	default n
	---help---
	  OmniVision 5.0M YUV Sensor

if OV5640
config OV5640_GLOBALOPTICS
	bool "Sensor ov5640 (YUV 5.0M), Module GLOBALOPTICS"
	depends on MSM_CAMERA
	default y
	---help---
	  OmniVision 5.0M YUV Sensor, Module GLOBALOPTICS
endif # OV5640
config HI704	
  bool "Sensor hi704(YUV 0.3M)"	
  depends on MSM_CAMERA	
  default n	
  ---help---	  
    Hynix 0.3M YUV Sensor
if HI704
config HI704_KERR	
  bool "Sensor hi704 (YUV 0.3M), Module KERR"	
  depends on MSM_CAMERA	
  default y	
  ---help---	  
    Hynix 0.3M YUV Sensor, Module KERR
endif # HI704

config MT9D115
	bool "Sensor mt9d115(YUV 2.0M)"
	depends on MSM_CAMERA && !ARCH_MSM8X60
	default n
	---help---
	  APTINA 2.0M YUV sensor

if MT9D115
config MT9D115_QTECH_SUNNY_SOCKET
	bool "Sensor mt9d115 (YUV 2.0M) of socket, Module QTECH or SUNNYOPTICAL"
	depends on MSM_CAMERA
	default y
	---help---
	  APTINA 2.0M YUV Sensor, Module QTECH or SUNNYOPTICAL

config MT9D115_QTECH_SUNNY_FPC
	bool "Sensor mt9d115 (YUV 2.0M) of FPC, Module QTECH or SUNNYOPTICAL"
	depends on MSM_CAMERA
	default n
	---help---
	  APTINA 2.0M YUV Sensor, Module QTECH or SUNNYOPTICAL
endif # MT9D115

config MT9D113
	bool "Sensor mt9d113(YUV 2.0M)"
	depends on MSM_CAMERA && !ARCH_MSM8X60
	default n
	---help---
	  APTINA 2.0M YUV sensor

if MT9D113
config MT9D113_QTECH_SUNNY_SOCKET
	bool "Sensor mt9d113 (YUV 2.0M) of socket, Module QTECH or SUNNYOPTICAL"
	depends on MSM_CAMERA
	default y
	---help---
	  APTINA 2.0M YUV Sensor, Module QTECH or SUNNYOPTICAL
endif # MT9D113

config S5K5CAGX
	bool "Sensor s5k5cagx(YUV 3.0M)"
	depends on MSM_CAMERA && !ARCH_MSM8X60
	default n
	---help---
	  SAMSUNG 3.0M YUV sensor

if S5K5CAGX
config S5K5CAGX_SAMSUNG_FPC
	bool "Sensor s5k5cagx (YUV 3.0M) of fpc, Module SAMSUNG"
	depends on MSM_CAMERA
	default y
	---help---
	  SAMSUNG 3.0M YUV Sensor, Module SAMSUNG
endif # S5K5CAGX

config S5K5CAGX_MCNEX_QTECH
	bool "Sensor s5k5cagx_mcnex_qtech(YUV 3.0M)"
	depends on MSM_CAMERA && !ARCH_MSM8X60
	default n
	---help---
	  SAMSUNG 3.0M YUV sensor

if S5K5CAGX_MCNEX_QTECH
config S5K5CAGX_MCNEX_QTECH_FPC
	bool "Sensor s5k5cagx_mcnex_qtech (YUV 3.0M) of fpc, Module MCNEX or QTECH"
	depends on MSM_CAMERA
	default y
	---help---
	  SAMSUNG 3.0M YUV Sensor, Module MCNEX or QTECH
endif # S5K5CAGX_MCNEX_QTECH

choice
	prompt "AF module"
	depends on MT9P012 && !ARCH_MSM8X60
	default MSM_CAMERA_AF_FOXCONN

config MSM_CAMERA_AF_FOXCONN
	bool "FOXCONN Module"
	help
	  This driver supports FOXCONN AF module for 5M Bayer sensor

config MSM_CAMERA_AF_BAM
	bool "BAM Module"
	help
	  This driver supports BAM AF module for 5M Bayer sensor
endchoice

config MT9P012_KM
	bool "Sensor mt9p012 KM module (BAYER 5M)"
	depends on MSM_CAMERA && !ARCH_MSM8X60
	default n
	---help---
	  MICRON 5M Bayer Sensor KM modules with Autofocus

config S5K3E2FX
	bool "Sensor s5k3e2fx (Samsung 5M)"
	depends on MSM_CAMERA && !ARCH_MSM8X60
	default n
	---help---
	  Samsung 5M with Autofocus

config VB6801
	bool "Sensor vb6801"
	depends on MSM_CAMERA && !ARCH_MSM8X60
	---help---
	  5M with flash

config SENSOR_ADAPTER
	bool "Adapter for different sensors"
	depends on MSM_CAMERA && !ARCH_MSM8X60
	default n
	---help---
	  Adapter for ov5642 and mt9t11x

config SENSOR_INFO
	bool "Get sensor info through EM"
	depends on MSM_CAMERA && !ARCH_MSM8X60
	default y
	---help---
	  Get sensor id and name through EM (Engineering Mode)
config MSM_CAMERA_FLASH
	bool "Qualcomm MSM camera flash support"
	depends on MSM_CAMERA && !ARCH_MSM8X60
	default n
	---help---
	  Enable support for LED flash for msm camera

config MSM_GEMINI
	tristate "Qualcomm MSM Gemini Jpeg Engine support"
	depends on MSM_CAMERA && (ARCH_MSM7X30 || ARCH_MSM8X60)
	default M
	---help---
	  Enable support for Gemini Jpeg Engine

config MSM_VPE
	tristate "Qualcomm MSM Video Pre-processing Engine support"
	depends on MSM_CAMERA && (ARCH_MSM7X30 || ARCH_MSM8X60)
	default y
	---help---
	  Enable support for Video Pre-processing Engine

config QUP_EXCLUSIVE_TO_CAMERA
	bool "QUP exclusive to camera"
	depends on MSM_CAMERA
	default y
	---help---
	  This flag enabled states that QUP
	  is exclusive to camera. In case this
	  is disabled, the lvs1 voltage is enabled
	  by QUP in the board file as QUP is used by
	  applications other than camera.

config CAMERA_N880
	bool "for blade_n880 camera"
	depends on MSM_CAMERA && !ARCH_MSM8X60
	default n
	---help---
	  it add motor power supply  different from other balde project 
```

## drivers/misc/modemctl/Kconfig
```kconfig
menu "Modemctl device drivers"
	

config MODEMCTL
	tristate "Modemctl driver"
	default no
	help
	  Modemctl driver.
	  This driver is required if you want to use Double modem 

	  Say Y here to compile support for Modemctl devices into the
	  kernel or say M to compile it as module (btusb).
	  
config MODEMCTL_IFX_GSM
	tristate "Modemctl driver ifx gsm modem support"
	depends on MODEMCTL
	help
	  Modemctl driver ifx gsm modem support.
	  This driver is required if you want to use IFX GSM modem

	  Say Y here to compile support for IFX Modem devices into the
	  kernel or say M to compile it as module (btsdio).

endmenu
```

## drivers/net/wireless/bcm4319/Kconfig
```kconfig
config DHD
	tristate "Broadcom 4319 wireless cards support"
	depends on WIRELESS_EXT && MMC
	---help---
	  This module adds support for wireless adapters based on
	  Broadcom 4329 chipset.

	  This driver uses the kernel's wireless extensions subsystem.

	  If you choose to build a module, it'll be called dhd. Say M if
	  unsure.
```

## drivers/staging/zram/Kconfig
```kconfig
config ZRAM
	tristate "Compressed in-memory block devices (zram)"
	depends on SWAP
	select LZO_COMPRESS
	select LZO_DECOMPRESS
	default n
	help
          Creates RAM based block devices named /dev/zram<id> (<id> = 0, 
          1, ...). Pages written to these disks are compressed and stored
          in memory itself. These disks allow very fast I/O and compression 
          provides good amounts of memory savings. Some of the usecases 
          include /tmp storage, use as swap disks, various caches under 
          /var and maybe many more :)

          Statistics for individual zram devices are exported through sysfs 
          nodes at /sys/block/zram<id>/

          Project home: http://compcache.googlecode.com/
```

## drivers/uv/Kconfig
```kconfig
#
# bladeuv module configuration
#

config BLADE_UNDERVOLT
	tristate "Blade undervolt"
	help
	  Say Y here if you want to build an undervolt module for Blade

	  If unsure, say N.

	  To compile this module, choose M here: the
	  module will be called Bladeuv.
```
